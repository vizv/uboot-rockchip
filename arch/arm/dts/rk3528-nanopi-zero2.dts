// SPDX-License-Identifier: (GPL-2.0+ OR MIT)
/*
 * (C) Copyright 2024 FriendlyElec Computer Tech. Co., Ltd.
 * (http://www.friendlyelec.com)
 *
 * Copyright (c) 2023 Rockchip Electronics Co., Ltd.
 */

/dts-v1/;
#include "rk3528.dtsi"
#include "rk3528-u-boot.dtsi"
#include <dt-bindings/input/input.h>

/ {
	model = "FriendlyElec boards based on Rockchip RK3528";
	compatible = "friendlyelec,nanopi-zero2", "rockchip,rk3528";

	adc-keys {
		compatible = "adc-keys";
		io-channels = <&saradc 1>;
		io-channel-names = "buttons";
		keyup-threshold-microvolt = <1800000>;
		u-boot,dm-pre-reloc;
		status = "okay";

		volumeup-key {
			u-boot,dm-pre-reloc;
			linux,code = <KEY_VOLUMEUP>;
			label = "volume up";
			press-threshold-microvolt = <9>;
		};
	};
};
