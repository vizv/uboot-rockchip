## arch/arm/mach-rockchip/rk3528/Kconfig
```kconfig
if ROCKCHIP_RK3528

config TARGET_EVB_RK3528
	bool "EVB_RK3528"
	select BOARD_LATE_INIT
	help
	  RK3528 EVB is a evaluation board for Rockchp RK3528.

config TARGET_NANOPI_ZERO2
	bool "FriendlyElec NanoPi Zero2 Series"
	select BOARD_LATE_INIT
	select VENDOR_FRIENDLYELEC
	help
	  Support for FriendlyElec boards based on RK3528.

config SYS_SOC
	default "rockchip"

config SYS_MALLOC_F_LEN
	default 0x400

source board/rockchip/evb_rk3528/Kconfig
source board/rockchip/nanopi_zero2/Kconfig

endif
```

## arch/arm/mach-rockchip/rk3568/Kconfig
```kconfig
if ROCKCHIP_RK3568

config TARGET_EVB_RK3568
	bool "EVB_RK3568"
	select BOARD_LATE_INIT
	help
	  RK3568 EVB is a evaluation board for Rockchp RK3568.

config TARGET_NANOPI5
	bool "FriendlyElec NanoPi 5 Series"
	select BOARD_LATE_INIT
	select VENDOR_FRIENDLYELEC
	help
	  Support for FriendlyElec boards based on RK3568.

config TARGET_NANOPI_R3
	bool "FriendlyElec NanoPi R3 Series"
	select BOARD_LATE_INIT
	select VENDOR_FRIENDLYELEC
	help
	  Support for FriendlyElec boards based on RK3566.

config SYS_SOC
	default "rockchip"

config SYS_MALLOC_F_LEN
	default 0x400

source board/rockchip/evb_rk3568/Kconfig
source board/rockchip/nanopi5/Kconfig
source board/rockchip/nanopi_r3/Kconfig

endif
```

## board/rockchip/nanopi_r3/Kconfig
```kconfig
if TARGET_NANOPI_R3

config SYS_BOARD
	default "nanopi_r3"

config SYS_VENDOR
	default "rockchip"

config SYS_CONFIG_NAME
	default "nanopi_r3"

config BOARD_SPECIFIC_OPTIONS
	def_bool y

endif
```

## board/rockchip/nanopi_zero2/Kconfig
```kconfig
if TARGET_NANOPI_ZERO2

config SYS_BOARD
	default "nanopi_zero2"

config SYS_VENDOR
	default "rockchip"

config SYS_CONFIG_NAME
	default "nanopi_zero2"

config BOARD_SPECIFIC_OPTIONS
	def_bool y

endif
```
